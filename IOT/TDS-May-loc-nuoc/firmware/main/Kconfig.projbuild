## IOT/TDS-May-loc-nuoc/firmware/main/Kconfig.projbuild
```kconfig
menu "Water filter network configuration"

config TDS_NETWORK_ENABLED
    bool "Enable Wi-Fi dashboard and Telegram notifications"
    default n

config TDS_WIFI_SSID
    string "Wi-Fi SSID"
    depends on TDS_NETWORK_ENABLED
    default ""

config TDS_WIFI_PASSWORD
    string "Wi-Fi password"
    depends on TDS_NETWORK_ENABLED
    default ""

config TDS_TELEGRAM_BOT_TOKEN
    string "Telegram bot token"
    depends on TDS_NETWORK_ENABLED
    default ""

config TDS_TELEGRAM_CHAT_ID
    string "Telegram chat ID"
    depends on TDS_NETWORK_ENABLED
    default ""

config TDS_NOTIFY_INTERVAL_SECONDS
    int "Notification interval in seconds"
    depends on TDS_NETWORK_ENABLED
    range 5 86400
    default 20

endmenu
```

## IOT/TDS-May-loc-nuoc/firmware/sdkconfig.defaults
```kconfig
CONFIG_ESPTOOLPY_FLASHSIZE_4MB=y
CONFIG_PARTITION_TABLE_SINGLE_APP_LARGE=y
CONFIG_LOG_DEFAULT_LEVEL_INFO=y
CONFIG_ESP_CONSOLE_UART_BAUDRATE=115200
```
